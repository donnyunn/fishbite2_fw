## main/Kconfig.projbuild
```kconfig
menu "Example Configuration"

    menu "Power Button"
        config GPIO_WAKEUP_PIN
            int "Wake-up Button GPIO Num"
            default 4 if IDF_TARGET_ESP32C3
            help
                GPIO number for Power Button
    endmenu

    menu "I2C Master"
        config I2C_MASTER_SCL
            int "SCL GPIO Num"
            default 6 if IDF_TARGET_ESP32C3
            default 19 if IDF_TARGET_ESP32 || IDF_TARGET_ESP32S2 || IDF_TARGET_ESP32S3
            help
                GPIO number for I2C Master clock line.

        config I2C_MASTER_SDA
            int "SDA GPIO Num"
            default 5 if IDF_TARGET_ESP32C3
            default 18 if IDF_TARGET_ESP32 || IDF_TARGET_ESP32S2 || IDF_TARGET_ESP32S3
            help
                GPIO number for I2C Master data line.

        config I2C_MASTER_PORT_NUM
            int "Port Number"
            default 1 if IDF_TARGET_ESP32 || IDF_TARGET_ESP32S2 || IDF_TARGET_ESP32S3
            default 0 if IDF_TARGET_ESP32C3
            help
                Port number for I2C Master device.

        config I2C_MASTER_FREQUENCY
            int "Master Frequency"
            default 100000
            help
                I2C Speed of Master device.
    endmenu

    menu "ADXL345 Sensor"
        choice ADXL345_ADDR
            prompt "ADXL345 I2C Address"
            default ADXL345_I2C_ADDRESS_LOW
            help
                Hardware address of ADXL345, which is 2 types, and determined by ADDR terminal.

            config ADXL345_I2C_ADDRESS_LOW
                bool "ADXL345 I2C Address(ADDR=0)"
                help
                    I2C Address of ADXL345 Sensor according to your schemetic configuration.

            config ADXL345_I2C_ADDRESS_High
                bool "ADXL345 I2C Address(ADDR=1)"
                help
                    I2C Address of ADXL345 Sensor according to your schemetic configuration.
        endchoice

        config ADXL345_ADDR
            hex
            default 0x1D if ADXL345_I2C_ADDRESS_High
            default 0x53 if ADXL345_I2C_ADDRESS_LOW
    endmenu

endmenu
```
